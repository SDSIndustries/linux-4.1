## Documentation/devicetree/bindings/iio/adc/at91-sama5d2_adc.txt
```
* AT91 SAMA5D2 Analog to Digital Converter (ADC)

Required properties:
  - compatible: Should be "atmel,sama5d2-adc".
  - reg: Should contain ADC registers location and length.
  - interrupts: Should contain the IRQ line for the ADC.
  - clocks: phandles to clocks.
  - clock-names: tuple listing clock names.
      Required elements: "adc_clk", "adc_op_clk". "adc_clk" is the peripheral
      clock, "adc_clk" is the sampling clock.
  - vref-supply: Supply used as reference for conversions.

Optional properties:
  - vddana-supply: Supply for the adc device.


Example:

adc: adc@fc030000 {
	compatible = "atmel,sama5d2-adc";
	reg = <0xfc030000 0x100>;
	interrupts = <40 IRQ_TYPE_LEVEL_HIGH 7>;
	clocks = <&adc_clk>, <&adc_op_clk>;
	clock-names = "adc_clk", "adc_op_clk";
	vddana-supply = <&vdd_3v3_lp_reg>;
	vref-supply = <&vdd_3v3_lp_reg>;
}
```

## Documentation/devicetree/bindings/mfd/atmel-flexcom.txt
```
* Device tree bindings for Atmel Flexcom (Flexible Serial Communication Unit)

The Atmel Flexcom is just a wrapper which embeds a SPI controller, an I2C
controller and an USART. Only one function can be used at a time and is chosen
at boot time according to the device tree.

Required properties:
- compatible:		Should be "atmel,sama5d2-flexcom"
- reg:			Should be the offset/length value for Flexcom dedicated
			I/O registers (without USART, TWI or SPI registers).
- clocks:		Should be the Flexcom peripheral clock from PMC.
- #address-cells:	Should be <1>
- #size-cells:		Should be <1>
- ranges:		Should be one range for the full I/O register region
			(including USART, TWI and SPI registers).
- atmel,flexcom-mode:	Should be one of the 3 following macros as defined in
			include/dt-bindings/mfd/atmel-flexcom.h:
			- ATMEL_FLEXCOM_MODE_USART for USART
			- ATMEL_FLEXCOM_MODE_SPI for SPI
			- ATMEL_FLEXCOM_MODE_TWI for I2C

Required child:
a single child device of type matching the "atmel,flexcom-mode" property.

The reg property of this child should be:
- <0x200 0x200> for USART
- <0x400 0x200> for SPI
- <0x600 0x200> for I2C

The phandle provided by the clocks property of the child is the same as one for
the Flexcom parent.

Other properties remain unchanged. See documentation of the respective device:
- ../serial/atmel-usart.txt
- ../spi/spi_atmel.txt
- ../i2c/i2c-at91.txt

Example:

flexcom@f8034000 {
	compatible = "atmel,sama5d2-flexcom";
	reg = <0xf8034000 0x200>;
	clocks = <&flx0_clk>;
	#address-cells = <1>;
	#size-cells = <1>;
	ranges = <0x0 0xf8034000 0x800>;
	atmel,flexcom-mode = <ATMEL_FLEXCOM_MODE_SPI>;

	spi@400 {
		compatible = "atmel,at91rm9200-spi";
		reg = <0x400 0x200>;
		interrupts = <19 IRQ_TYPE_LEVEL_HIGH 7>;
		pinctrl-names = "default";
		pinctrl-0 = <&pinctrl_flx0_default>;
		#address-cells = <1>;
		#size-cells = <0>;
		clocks = <&flx0_clk>;
		clock-names = "spi_clk";
		atmel,fifo-size = <32>;

		mtd_dataflash@0 {
			compatible = "atmel,at25f512b";
			reg = <0>;
			spi-max-frequency = <20000000>;
		};
	};
};
```

## Documentation/devicetree/bindings/mtd/atmel-quadspi.txt
```
* Atmel Quad Serial Peripheral Interface (QSPI)

Required properties:
- compatible:     should be "atmel,sama5d2-qspi"
- reg:            the first contains the register location and length,
                  the second contains the memory mapping address and length
- interrupts:     should contain the interrupt for the device
- clocks:         the phandle of the clock needed by the QSPI controller
- #address-cells: should be <1>
- #size-cells:    should be <0>

Example:

spi@f0020000 {
	compatible = "atmel,sama5d2-qspi";
	reg = <0xf0020000 0x100>,
	      <0xd0000000 0x8000000>;
	interrupts = <52 IRQ_TYPE_LEVEL_HIGH 7>;
	clocks = <&spi0_clk>;
	#address-cells = <1>;
	#size-cells = <0>;
	pinctrl-names = "default";
	pinctrl-0 = <&pinctrl_spi0_default>;
	status = "okay";

	m25p80@0 {
		...
	};
};
```

## arch/arm/boot/controller.its
```
/*
 * Simple U-boot uImage source file containing a single kernel
 */

/dts-v1/;

/ {
	description = "SDS Controller Kernel";
	#address-cells = <1>;

	images {
		kernel@1 {
			description = "SDS Controller Linux kernel";
			data = /incbin/("./zImage");
			type = "kernel";
			arch = "arm";
			os = "linux";
			compression = "none";
			load = <0x20008000>;
			entry = <0x20008000>;
			hash@1 {
				algo = "crc32";
			};
			hash@2 {
				algo = "sha1";
			};
		};
		fdt@1 {
			description = "SDS Controller FDT Blob";
			data = /incbin/("./dts/sama5d36ek.dtb");
			type = "flat_dt";
			arch = "arm";
			compression = "none";
			hash@1 {
				algo = "crc32";
			};
			hash@2 {
				algo = "sha1";
			};
		};
	};

	configurations {
		default = "config@1";
		config@1 {
			description = "Boot Linux kernel";
			kernel = "kernel@1";
			fdt = "fdt@1";
		};
	};

};
```
